## build-debug/conf/local.conf
```bitbake
MACHINE = "qemuarm64"
SSTATE_DIR = "/home/ilab01/yp-summit-nov-21/poky/sstate-cache"
DL_DIR = "/home/ilab01/yp-summit-nov-21/poky/downloads"
IMAGE_FEATURES:append = " tools-debug"
IMAGE_INSTALL:append = " openssh gdbserver fping fping-dbg fping-src valgrind valgrind-dbg"
SECURITY_CFLAGS:pn-fping = "${SECURITY_NOPIE_CFLAGS}"
SECURITY_CFLAGS:pn-valgrind = "${SECURITY_NOPIE_CFLAGS}"
DEBUG_BUILD:pn-fping = "1"
```

## build-devtool/conf/local.conf
```bitbake
# Class settings for the YP Summit 2021.11
MACHINE = "qemuarm64"
SSTATE_DIR = "/home/ilab01/yp-summit-nov-21/poky/sstate-cache"
DL_DIR = "/home/ilab01/yp-summit-nov-21/poky/downloads"
IMAGE_INSTALL:append = " gdbserver openssh "
WARN_QA:append = " version-going-backwards"
ERROR_QA:append = "version-going-backwards"
EXTRA_IMAGE_FEATURES += "debug-tweaks dbg-pkgs dev-pkgs package-management"
```

## build-kernel/conf/local.conf
```bitbake
MACHINE ?= "qemuarm64"
SSTATE_DIR = "/home/ilab01/yp-summit-nov-21/poky/sstate-cache"
DL_DIR = "/home/ilab01/yp-summit-nov-21/poky/downloads"
```

## conf/layer.conf
```bitbake
# We have a conf and classes directory, add to BBPATH
BBPATH .= ":${LAYERDIR}"

# We have recipes-* directories, add to BBFILES
BBFILES += "${LAYERDIR}/recipes-*/*/*.bb ${LAYERDIR}/recipes-*/*/*.bbappend"

BBFILE_COLLECTIONS += "training"
BBFILE_PATTERN_training = "^${LAYERDIR}/"
LAYERSERIES_COMPAT_training = "honister"

# This should only be incremented on significant changes that will
# cause compatibility issues with other layers
LAYERVERSION_training = "1"

LAYERDEPENDS_training = "core"
```
